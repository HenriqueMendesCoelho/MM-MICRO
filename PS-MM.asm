; PS - MM
; Integrantes
; HENRIQUE MENDES COELHO RODRIGUES RM:81242
; LUCAS FERNANDO CARDOSO GONÇALVES RM:81333
; LUIZ FELIPE CARDOSO GONÇALVES RM:80721



;Definindo o microcontrolador
#INCLUDE <P18F452.INC>

CBLOCK 0x80		; ENDEREÇO INICIAL DA MEMÓRIA DE DADOS
	
			; ABAIXO SÃO CRIADAS VARIÁVEIS PARA AS INTERRUPÇÕES
	W_TEMP		; VARIÁVEL PARA ARMAZENAR O CONTEXTO
				; ATUAL DO REGISTRADOR WORK
	STATUS_TEMP	; VARIÁVEL PARA ARMAZENAR O CONTEXTO
				; ATUAL DO REGISTRADOR STATUS
	BSR_TEMP	; VARIÁVEL PARA ARMAZENAR O CONTEXTO
				; ATUAL DO REGISTRADOR BSR
	TEMPO		; ARMAZENA O VALOR DO TEMPO
	TEMP1		; VARIÁVEIS AUXILIARES
ENDC


V_INICIO EQU .2
T_FILTRO EQU .230


;Definindo as variaveis

;GATILHO
#DEFINE BOTAO_RB1 PORTB,1
;BATERIA
#DEFINE BAT_RB2 PORTB,2
;SCANNER
#DEFINE SCAN_RB3 PORTB,3

;LED VERDE
#DEFINE LED_D1 PORTC,1
;LED VERMELHO
#DEFINE LED_D2 PORTC,2
;LED LARANJA
#DEFINE LED_D3 PORTC,3

ORG 0X00
GOTO CFG


ORG 0x08

MOVWF W_TEMP
MOVFF STATUS,STATUS_TEMP
MOVFF BSR,BSR_TEMP		
								

BTFSS INTCON,TMR0IF		
GOTO SAI_INT	


BCF INTCON, TMR0IF
MOVLW .256-.125
MOVWF TMR0	
DECFSZ TEMP1,F
GOTO SAI_INT

MOVLW .125
MOVWF TEMP1

DECFSZ TEMPO,F
GOTO SAI_INT

MOVLW V_INICIO
MOVWF TEMPO

BCF LED_D2 ;APAGA O LED VERMELHO
BSF LED_D1 ;ACENDE O LED VERDE


SAI_INT							

	MOVFF BSR_TEMP,BSR		
	MOVF W_TEMP,W
	MOVFF STATUS_TEMP,STATUS

	RETFIE

TEMP
	BCF INTCON,TMR0IF
	MOVLW .256-.125
	MOVWF TMR0
	MOVLW .125
	MOVWF TEMP1
	BSF INTCON,GIE
	
	RETURN

DESLIGA_TEMP
	BCF INTCON,GIE
	RETURN

CFG
	
	MOVLW V_INICIO
	MOVWF TEMPO

	CLRF PORTB
	CLRF PORTC
	MOVLW B'00001110'
	MOVWF TRISB
	MOVLW B'00000000'
	MOVWF TRISC
	MOVLW B'11000110'
	MOVWF T0CON
	MOVLW B'00100000'
	MOVWF INTCON
	
	BSF LED_D1

MAIN	

	;LÓGICA DE VERIFICAÇÃO DA BATERIA
	BTFSC BAT_RB2
	GOTO BAT_RB2_LOW

	GOTO BAT_RB2_NORMAL

	BAT_RB2_NORMAL
		BCF LED_D3 ;APAGA O LED LARANJA
		GOTO INICIO

	BAT_RB2_LOW
		BSF LED_D3 ;ACENDE O LED LARANJA
		GOTO INICIO
	;FIM DA LOGICA DA BATERIA
	
	INICIO ;INICIO DO CODIGO PRINCIPAL
	
	BTFSC BOTAO_RB1
	GOTO BOTAO_RB1_LIB

	GOTO BOTAO_RB1_PRESS
	
	;CASO O BOTAR IHM NÃO FOR PRESSIONADO NADA ACONTECE E VOLTA AO MAIN
	BOTAO_RB1_LIB
		CALL DESLIGA_TEMP
		GOTO MAIN

	BOTAO_RB1_PRESS
		;VERIFICAÇÃO DO SCANNER CASO O BOTÃO DE IHM SEJA PRESSIONADO
		BTFSC SCAN_RB3
		GOTO SCAN_RB3_LIB
		
		;CASO O SCANNER ESTEJA OCUPADO NADA ACONTECE E VOLTA A MAIN
		GOTO SCAN_RB3_OCUPADO
		SCAN_RB3_OCUPADO
			GOTO MAIN
		
		SCAN_RB3_LIB
			BCF LED_D1 ;APAGA O LED VERDE
			BSF LED_D2 ;ACENDE O LED VERMELHO
			CALL TEMP
			
			GOTO MAIN

END